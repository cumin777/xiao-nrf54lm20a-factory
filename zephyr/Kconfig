## zephyr/Kconfig
```kconfig
source "Kconfig.zephyr"

menu "Factory AT Parameters"

config FACTORY_VBUS_USB_MIN_MV
	int "State1 USB VBUS reference threshold (mV)"
	range 0 10000
	default 4900
	help
	  Host-side reference threshold for State1 VBUS checks.

config FACTORY_3V3_MIN_MV
	int "State1/8B 3V3 reference threshold (mV)"
	range 0 5000
	default 3200
	help
	  Host-side reference threshold for 3V3 checks.

config FACTORY_VBUS_BAT_MAX_MV
	int "PhaseB-State8 VBUS reference threshold (mV)"
	range 0 5000
	default 500
	help
	  Host-side reference threshold for battery-only VBUS recheck.

config FACTORY_ADC_VBUS_CHANNEL
	int "ADC channel index for VBUS sampling"
	range 0 7
	default 0
	help
	  Maps VBUS sampling to zephyr,user io-channels index.

config FACTORY_ADC_3V3_CHANNEL
	int "ADC channel index for 3V3 sampling"
	range 0 7
	default 1
	help
	  Maps 3V3 sampling to zephyr,user io-channels index.

config FACTORY_ADC_BATV_CHANNEL
	int "ADC channel index for BATV fallback sampling"
	range 0 7
	default 2
	help
	  Maps BATV fallback sampling to zephyr,user io-channels index.

config FACTORY_CHGCUR_REF_MA
	int "State2 charge current reference (mA)"
	range 0 5000
	default 0
	help
	  Host-side reference value for CHGCUR checks (firmware does not judge PASS/FAIL).

config FACTORY_BATV_DELTA_MAX_MV
	int "State2 BATV reference delta (mV)"
	range 0 2000
	default 200
	help
	  Host-side reference delta for BATV checks (firmware does not judge PASS/FAIL).

config FACTORY_SLEEPI_WINDOW_MS
	int "State5 sleep current sampling window (ms)"
	range 10 10000
	default 1000
	help
	  Delay between pre/post current samples for AT+SLEEPI.

config FACTORY_SLEEPI_REF_UA
	int "State5 sleep current reference (uA)"
	range 0 2000000
	default 0
	help
	  Host-side reference current for SLEEPI checks (firmware does not judge PASS/FAIL).

config FACTORY_BLE_SCAN_WINDOW_MS
	int "State3 BLE scan window (ms)"
	range 100 10000
	default 1500
	help
	  Active scan duration used by AT+BLESCAN.

config FACTORY_BLE_RSSI_REF_DBM
	int "State3 BLE RSSI reference (dBm)"
	range -127 20
	default -70
	help
	  Host-side reference RSSI for BLESCAN (firmware does not judge PASS/FAIL).

config FACTORY_DMIC_SAMPLE_RATE_HZ
	int "DMIC sample rate (Hz)"
	range 8000 48000
	default 16000
	help
	  Sampling rate used by AT+MICAMP lightweight capture.

config FACTORY_DMIC_BLOCK_SIZE
	int "DMIC capture block size (bytes)"
	range 256 4096
	default 640
	help
	  Audio block size for single-shot MIC amplitude capture.

config FACTORY_DMIC_READ_TIMEOUT_MS
	int "DMIC read timeout (ms)"
	range 100 5000
	default 1000
	help
	  Timeout used while waiting for one DMIC block in AT+MICAMP.

endmenu
```
